// Small driver for the 1.8" ST7735 128x160 colour screen, used in landscape (160 x 128).
// Only what the HMI needs: filled boxes, text in a 5x7 font (any size) and 7-segment numbers.
// Wiring: SCK D13, SDA (MOSI) D11, A0/DC D9, RESET D8, CS D10, LED 3.3 V, VCC 5 V, GND.
#pragma once

#define TFT_W 160
#define TFT_H 128

// colours, RGB565
#define C_BLACK   0x0000
#define C_WHITE   0xFFFF
#define C_BG      0x10A2   // dark blue-grey page
#define C_PANEL   0x2124   // slightly lighter panel
#define C_LINE    0x4228
#define C_TEXT    0xE73C   // off white
#define C_DIM     0x8C51   // grey text
#define C_GO      0x2D6A   // green
#define C_GOLITE  0x5FED
#define C_AMBER   0xFD20
#define C_RED     0xD8A4
#define C_NET     0xC985   // the red of the net
#define C_BLUE    0x3D3F
#define C_SEL     0x3A6F   // selected row

// 5x7 font, ASCII 32..126, then a few symbols (0x7F..0x84): up, down, right, left, dot, tick
const uint8_t FONT5X7[] PROGMEM = {
  0x00,0x00,0x00,0x00,0x00, 0x00,0x00,0x5F,0x00,0x00, 0x00,0x07,0x00,0x07,0x00, 0x14,0x7F,0x14,0x7F,0x14,
  0x24,0x2A,0x7F,0x2A,0x12, 0x23,0x13,0x08,0x64,0x62, 0x36,0x49,0x55,0x22,0x50, 0x00,0x05,0x03,0x00,0x00,
  0x00,0x1C,0x22,0x41,0x00, 0x00,0x41,0x22,0x1C,0x00, 0x08,0x2A,0x1C,0x2A,0x08, 0x08,0x08,0x3E,0x08,0x08,
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  0x10,0x20,0x10,0x08,0x04    // 0x84 tick
};
#define SYM_UP    "\x7F"
#define SYM_DOWN  "\x80"
#define SYM_RIGHT "\x81"
#define SYM_LEFT  "\x82"
#define SYM_DOT   "\x83"

// screen options (kept in EEPROM): type 0 = black tab (most red 1.8" boards), 1 = green tab, 2 = red tab
byte tftType = 0;
bool tftFlip = false;
byte tftOffX = 0, tftOffY = 0;

#ifdef __AVR__
  #define TFT_DC_LOW()   (PORTB &= ~_BV(1))   // D9
  #define TFT_DC_HIGH()  (PORTB |=  _BV(1))
  #define TFT_CS_LOW()   (PORTB &= ~_BV(2))   // D10
  #define TFT_CS_HIGH()  (PORTB |=  _BV(2))
  static inline void spiOut(uint8_t b) { SPDR = b; while (!(SPSR & _BV(SPIF))); }
  static inline void tftCmd(uint8_t c) { TFT_DC_LOW(); spiOut(c); TFT_DC_HIGH(); }
  static inline void tftData(uint8_t d) { spiOut(d); }
  static void tftPush(uint16_t c, uint16_t n) { uint8_t hi = c >> 8, lo = c; while (n--) { spiOut(hi); spiOut(lo); } }
  static inline void tftBegin() { TFT_CS_LOW(); }
  static inline void tftEnd() { TFT_CS_HIGH(); }
  static void tftWindow(uint8_t x, uint8_t y, uint8_t w, uint8_t h) {
    tftCmd(0x2A); tftData(0); tftData(x + tftOffX); tftData(0); tftData(x + w - 1 + tftOffX);
    tftCmd(0x2B); tftData(0); tftData(y + tftOffY); tftData(0); tftData(y + h - 1 + tftOffY);
    tftCmd(0x2C);
  }
#else
  // test bench: the screen is a picture in memory
  uint16_t fb[TFT_H][TFT_W];
  static uint8_t wx, wy, ww, wh, cx, cy;
  static inline void tftBegin() {}
  static inline void tftEnd() {}
  static inline void tftCmd(uint8_t) {}
  static inline void tftData(uint8_t) {}
  static void tftWindow(uint8_t x, uint8_t y, uint8_t w, uint8_t h) { wx = x; wy = y; ww = w; wh = h; cx = 0; cy = 0; }
  void simPixelTime(unsigned long n);
  static void tftPush(uint16_t c, uint16_t n) {
    simPixelTime(n);
    while (n--) {
      if (wy + cy < TFT_H && wx + cx < TFT_W) fb[wy + cy][wx + cx] = c;
      if (++cx >= ww) { cx = 0; cy++; }
    }
  }
#endif

// init lists: command, number of arguments (bit 7 = delay follows), arguments, [delay ms]
const uint8_t TFT_INIT[] PROGMEM = {
  0x01, 0x80, 150,                  // software reset
  0x11, 0x80, 255,                  // out of sleep
  0xB1, 3, 0x01, 0x2C, 0x2D,        // frame rate
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  0x29, 0x80, 100,                  // display on
  0x00
};

void tftSetRotation() {                  // landscape; flip turns it 180 degrees
  uint8_t mad = tftFlip ? 0x60 : 0xA0;   // MX|MV or MY|MV
  if (tftType != 0) mad |= 0x08;         // green and red tab boards are BGR
  tftOffX = (tftType == 1) ? 1 : 0;      // green tab: 2 columns / 1 row offset (swapped in landscape)
  tftOffY = (tftType == 1) ? 2 : 0;
  tftBegin(); tftCmd(0x36); tftData(mad); tftEnd();
}

void tftInit() {
#ifdef __AVR__
  pinMode(8, OUTPUT); pinMode(9, OUTPUT); pinMode(10, OUTPUT); pinMode(11, OUTPUT); pinMode(13, OUTPUT);
  TFT_CS_HIGH();
  SPCR = _BV(SPE) | _BV(MSTR);           // SPI master, mode 0
  SPSR = _BV(SPI2X);                     // 8 MHz
  digitalWrite(8, HIGH); delay(5); digitalWrite(8, LOW); delay(20); digitalWrite(8, HIGH); delay(150);   // hardware reset
  tftBegin();
  const uint8_t *p = TFT_INIT;
  for (;;) {
    uint8_t c = pgm_read_byte(p++);
    if (!c) break;
    uint8_t n = pgm_read_byte(p++);
    tftCmd(c);
    for (uint8_t i = 0; i < (n & 0x7F); i++) tftData(pgm_read_byte(p++));
    if (n & 0x80) { uint8_t d = pgm_read_byte(p++); delay(d == 255 ? 500 : d); }
  }
  tftEnd();
#endif
  tftSetRotation();
}

void fillRect(int x, int y, int w, int h, uint16_t c) {
  if (x < 0) { w += x; x = 0; }
  if (y < 0) { h += y; y = 0; }
  if (x + w > TFT_W) w = TFT_W - x;
  if (y + h > TFT_H) h = TFT_H - y;
  if (w <= 0 || h <= 0) return;
  tftBegin(); tftWindow(x, y, w, h); tftPush(c, (uint16_t)w * h); tftEnd();
}
static inline void hLine(int x, int y, int w, uint16_t c) { fillRect(x, y, w, 1, c); }

// one character cell (6 x 8 at size 1), drawn with its background so no clearing is needed
void drawChar(int x, int y, char ch, uint16_t fg, uint16_t bg, uint8_t s) {
  uint8_t c = (uint8_t)ch;
  if (c < 32 || c > 0x84) c = '?';
  const uint8_t *g = FONT5X7 + (c - 32) * 5;
  uint8_t col[6];
  for (uint8_t i = 0; i < 5; i++) col[i] = pgm_read_byte(g + i);
  col[5] = 0;
  if (x < 0 || y < 0 || x + 6 * s > TFT_W || y + 8 * s > TFT_H) return;
  tftBegin(); tftWindow(x, y, 6 * s, 8 * s);
  for (uint8_t r = 0; r < 8; r++)
    for (uint8_t rs = 0; rs < s; rs++)
      for (uint8_t i = 0; i < 6; i++) tftPush((col[i] >> r) & 1 ? fg : bg, s);
  tftEnd();
}

// text from RAM or flash; returns the x after the text
int drawText(int x, int y, const char *t, uint16_t fg, uint16_t bg, uint8_t s) {
  while (*t) { drawChar(x, y, *t++, fg, bg, s); x += 6 * s; }
  return x;
}
int drawTextP(int x, int y, const __FlashStringHelper *ft, uint16_t fg, uint16_t bg, uint8_t s) {
  const char *t = (const char *)ft; char ch;
  while ((ch = pgm_read_byte(t++))) { drawChar(x, y, ch, fg, bg, s); x += 6 * s; }
  return x;
}
uint8_t lenP(const __FlashStringHelper *ft) { const char *t = (const char *)ft; uint8_t n = 0; while (pgm_read_byte(t++)) n++; return n; }

// 7-segment digits for the big counter: w x h box, segment thickness t
const uint8_t SEG7[10] PROGMEM = { 0x3F, 0x06, 0x5B, 0x4F, 0x66, 0x6D, 0x7D, 0x07, 0x7F, 0x6F };   // gfedcba
void drawSeg(int x, int y, char d, uint8_t w, uint8_t h, uint8_t t, uint16_t on, uint16_t off) {
  uint8_t m = (d >= '0' && d <= '9') ? pgm_read_byte(SEG7 + d - '0') : (d == '-' ? 0x40 : 0);
  uint8_t h2 = h / 2;
  fillRect(x + t, y, w - 2 * t, t, m & 0x01 ? on : off);                      // a
  fillRect(x + w - t, y + t, t, h2 - t - t / 2, m & 0x02 ? on : off);           // b
  fillRect(x + w - t, y + h2 + (t + 1) / 2, t, h2 - t - t / 2, m & 0x04 ? on : off);   // c
  fillRect(x + t, y + h - t, w - 2 * t, t, m & 0x08 ? on : off);              // d
  fillRect(x, y + h2 + (t + 1) / 2, t, h2 - t - t / 2, m & 0x10 ? on : off);    // e
  fillRect(x, y + t, t, h2 - t - t / 2, m & 0x20 ? on : off);                   // f
  fillRect(x + t, y + h2 - t / 2, w - 2 * t, t, m & 0x40 ? on : off);           // g
}

// number to text with a fixed number of decimals
char *fmtNum(char *buf, float v, uint8_t dp) {
  long m = 1; for (uint8_t i = 0; i < dp; i++) m *= 10;
  bool neg = v < 0; if (neg) v = -v;
  unsigned long n = (unsigned long)(v * m + 0.5);
  char tmp[14]; uint8_t k = 0;
  for (uint8_t i = 0; i < dp; i++) { tmp[k++] = '0' + n % 10; n /= 10; }
  if (dp) tmp[k++] = '.';
  do { tmp[k++] = '0' + n % 10; n /= 10; } while (n);
  char *p = buf; if (neg) *p++ = '-';
  while (k) *p++ = tmp[--k];
  *p = 0;
  return buf;
}
